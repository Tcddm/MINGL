## Kconfig
```kconfig
mainmenu "MINGL 配置"

choice
    prompt "目标平台"
    default MGL_PLATFORM_SDL
config MGL_PLATFORM_SDL
    bool "SDL2模拟器"
config MGL_PLATFORM_FB
    bool "Linux FrameBuffer"	
endchoice

osource "platform/sdl/Kconfig"
osource "platform/fb/Kconfig"

menu "硬件加速特性"

config MGL_HW_ACCEL_FILL_RECT
    bool "填充矩形"
	depends on MGL_FRAMEBUFFER_NONE
config MGL_HW_ACCEL_BIT_BLT
    bool "位图传输"
	depends on MGL_FRAMEBUFFER_NONE
config MGL_HW_ACCEL_ALPHA_BLEND
    bool "alpha混合"
	
endmenu	
	
config MGL_SCREEN_WIDTH
    int "屏幕宽度（px）"
    default 480
config MGL_SCREEN_HEIGHT
    int "屏幕高度（px）"
    default 320

menu "图形缓冲"

choice
    prompt "帧缓冲模式"
    default MGL_FRAMEBUFFER_EXTERNAL if MGL_PLATFORM_FB
    default MGL_FRAMEBUFFER_NONE

config MGL_FRAMEBUFFER_NONE
    bool "无缓冲（直接写屏）"

config MGL_FRAMEBUFFER_INTERNAL
    bool "内部缓冲（框架分配）"

config MGL_FRAMEBUFFER_EXTERNAL
    bool "外部缓冲（用户提供）"

endchoice

endmenu	
	
config MGL_PAGE_POOL_SIZE
    int "页面池大小（bytes）"
    default 2048
config MGL_PAGE_STACK_MAX_DEPTH
    int "页面栈深度"
    default 8
config MGL_MAX_WIDGET_DEPTH
    int "控件最大嵌套深度"
    default 8
config MGL_HIT_TEST_MAX_DEPTH
    int "事件命中测试最大深度"
    default 12	
config MGL_DIRTY_RECT_MAX_COUNT
    int "控件区域中最大合并矩形数"
    default 4
config MGL_TOUCH_MAX_FINGERS
    int "触屏最多点数"
    default 1
config MGL_FILL_POLYGON_MAX_INTERSECTS
    int "填充多边形最大交点数"
    default 128
config MGL_OVERLAY
    bool "全局Overlay支持"
    default y
config MGL_TIMER_POOL_SIZE
    int "全局定时器池大小"
    default 4
config MGL_TIMER_MAX_ACTIVE
    int "同时活跃定时器上限"
    default 4
menu "日志"

config MGL_LOG_ENABLE_DBG
    bool "调试日志（DBG）"
    default n
	
menu "调试日志选项"
depends	on MGL_LOG_ENABLE_DBG

config MGL_LOG_ENABLE_LAYOUT
    bool "布局与测量日志"
    default y
	
config MGL_LOG_ENABLE_RENDER
    bool "渲染日志"
    default y	
	
config MGL_LOG_ENABLE_EVENT
    bool "事件日志"
    default y		
	
endmenu	

config MGL_LOG_ENABLE_INFO
    bool "信息日志（INFO）"
    default y

config MGL_LOG_ENABLE_ERROR
    bool "错误日志（ERROR）"
    default y
	
config MGL_FPS_LOG
    bool "FPS日志输出"
    default y
	
config MGL_FPS_REPORT_INTERVAL_MS
    int "FPS日志输出间隔（ms）"
    default 2000
	depends on MGL_FPS_LOG		

endmenu	

config MGL_WIDGET_NAME_FIELD_ENABLE
	bool "控件name字段"
	default y
config MGL_DEMO
    bool "启用示例界面"
    default y
menu "示例界面"
    depends on MGL_DEMO
    choice
        prompt "选择要编译的示例"
        default MGL_DEMO_HELLO
		config MGL_DEMO_HELLO
            bool "Hello示例"
        config MGL_DEMO_DEV
            bool "开发示例 (dev)"
    endchoice

endmenu

menu "字体生成工具"

config MGL_TOOL_ACCEL_FONT_GEN
    bool "启用字体生成工具"
    default y

config MGL_FONT_GEN_SCAN_PATH
    string "源码扫描路径"
    default "demo"
	depends on !MGL_DEMO
    depends on MGL_TOOL_ACCEL_FONT_GEN

config MGL_FONT_GEN_FONT_PATH
    string "TTF字体目录"
    default "tools/font"
    depends on MGL_TOOL_ACCEL_FONT_GEN

config MGL_FONT_GEN_DEFAULT_FONT
    string "默认字体文件名"
    default "MiSans-Normal.ttf"
    depends on MGL_TOOL_ACCEL_FONT_GEN

config MGL_FONT_GEN_DEFAULT_SIZE
    int "默认字号（px）"
    default 16
    depends on MGL_TOOL_ACCEL_FONT_GEN

endmenu	
```

## platform/fb/Kconfig
```kconfig
if MGL_PLATFORM_FB
menu "Linux FrameBuffer平台选项"
config MGL_PLATFORM_FB_FB_DEVICE
    string "FrameBuffer设备节点"
    default "/dev/fb0"

config MGL_TOUCH_EVDEV
    bool "evdev触摸"
    default y

config MGL_TOUCH_EVDEV_DEVICE
    string "触摸屏设备节点"
    default "/dev/input/event1"
    depends on MGL_TOUCH_EVDEV
endmenu
endif
```

## platform/sdl/Kconfig
```kconfig
if MGL_PLATFORM_SDL
menu "SDL模拟器平台选项"
config MGL_HW_ACCEL_FILL_RECT
    default y
config MGL_HW_ACCEL_BIT_BLT
    default y
config MGL_EGG_ENABLE
    bool "Easter egg"
    default n
endmenu
endif
```
